## config/west.yml
```yaml
manifest:
  remotes:
    - name: zmkfirmware
      url-base: https://github.com/imhy123
    - name: DoctorWangWang
      url-base: https://github.com/DoctorWangWang
  projects:
    - name: zmk
      remote: zmkfirmware
      revision: ffe4a82adab810e8a07c1fe119fe7a933eb2353e # imhy123/zmk v0.3-branch
      import: app/west.yml
    - name: zmk-pmw3610-driver
      remote: DoctorWangWang
      revision: 1d9c2c68ca76012e1b1e5f6ef02fa5eadc4ca399 # DoctorWangWang driver
      
  self:
    path: config
```
